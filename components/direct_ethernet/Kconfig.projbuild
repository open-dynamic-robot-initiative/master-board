## components/direct_ethernet/Kconfig.projbuild
```kconfig
menu "Direct_Ethernet"

    config MAX_ETH_DATA_LEN
        int "Maximum payload length"
        default 250
        range 0 1500
        help
            Maximum length of the payload of the ethernet frame (in bytes).

endmenu
```

## components/direct_wifi/Kconfig.projbuild
```kconfig
menu "Direct_Wifi"
	
	config CHANNEL
        int "Channel"
        default 9
        range 1 13
        help
            The channel on which sending and receiving ESPNOW data.

    choice DATARATE
        prompt "WiFi datarate"
        default DATARATE_24
        help
            WiFi datarate.

        config DATARATE_6
            bool "6 MBps"
        config DATARATE_9
            bool "9 MBps"
        config DATARATE_12
            bool "12 MBps"
        config DATARATE_18
            bool "18 MBps"
        config DATARATE_24
            bool "24 MBps"
        config DATARATE_36
            bool "36 MBps"
        config DATARATE_48
            bool "48 MBps"
        config DATARATE_56
            bool "56 MBps"
    endchoice

endmenu
```

## components/my_ethernet/Kconfig.projbuild
```kconfig
menu "My_ethernet"

    config MAX_ETH_DATA_LEN
        int "Maximum payload length"
        default 128
        range 0 1500
        help
            Maximum length of the payload of the ethernet frame (in bytes).

endmenu
```

## firmware/main/Kconfig.projbuild
```kconfig
menu "Main App"
	
	config N_SLAVES
        int "SPI slave nb"
        default 6
        range 0 8
        help
            Number of SPI slaves to handle.

    config WIFI_ETH_TIMEOUT_ACK
        int "Timeout wifi/eth while waiting for first command"
        default 1000
        help
            Maximeum time in ms for which the masterboard will wait for the first command packet
            via wifi/ethernet after initialization


    config WIFI_ETH_TIMEOUT_CONTROL
            int "Timeout wifi/eth while in control mode"
            default 20
            help
                Maximum time in ms without the masterboard receiving any data from wifi/ethernet
                while in active control mode


    config SPI_N_ATTEMPT
        int "SPI nb of attempts"
        default 2
        range 0 4
        help
            Maximum number of attempts in one spi communication (for one slave).

	config LED_GPIO
        int "Built-In LED GPIO"
        default 2
        range 0 39
        help
            Output GPIO on which the built-in led is wired.    

	config BUTTON_GPIO
	        int "Intput button GPIO"
	        default 36
	        range 0 39
	        help
	            Input GPIO on which the button (pull-down) is wired.

endmenu
```

## firmware/sdkconfig.defaults
```kconfig
# baudrates
CONFIG_ESPTOOLPY_BAUD_115200B=
CONFIG_ESPTOOLPY_BAUD_2MB=y

CONFIG_ESPTOOLPY_MONITOR_BAUD_115200B=
CONFIG_ESPTOOLPY_MONITOR_BAUD_2MB=y

# CPU frequency
CONFIG_ESP32_DEFAULT_CPU_FREQ_160=
CONFIG_ESP32_DEFAULT_CPU_FREQ_240=y
CONFIG_ESP32_DEFAULT_CPU_FREQ_MHZ=240

# ethernet stuff
CONFIG_ETH_RMII_CLK_INPUT=
CONFIG_ETH_RMII_CLK_OUTPUT=y
CONFIG_ETH_RMII_CLK_OUT_GPIO=17

# disabling 'useless' messages for this project
CONFIG_LWIP_ESP_GRATUITOUS_ARP=n
CONFIG_LWIP_DHCP_DOES_ARP_CHECK=n

# main app and SPI should be running on core 0
# attach WiFi and ESPNOW tasks to core 1
CONFIG_ESP32_WIFI_TASK_PINNED_TO_CORE_0=
CONFIG_ESP32_WIFI_TASK_PINNED_TO_CORE_1=y
```

## main/Kconfig.projbuild
```kconfig
menu "Main App"
	
	config N_SLAVES
        int "SPI slave nb"
        default 6
        range 0 8
        help
            Number of SPI slaves to handle.

endmenu
```

## sdkconfig.defaults
```kconfig
#disabling 'Useless' messages for this project

CONFIG_ESP_GRATUITOUS_ARP=n
CONFIG_LWIP_DHCP_DOES_ARP_CHECK=n


# main app and SPI should be running on core 0
# So attach WiFi and ESPNOW tasks to core 1
CONFIG_ESP32_WIFI_TASK_PINNED_TO_CORE_0=
CONFIG_ESP32_WIFI_TASK_PINNED_TO_CORE_1=y
```

## software/components/direct_wifi/Kconfig.projbuild
```kconfig
menu "Direct_Wifi"
	
	config WIFI_CHANNEL
        int "Channel"
        default 9
        range 1 13
        help
            The channel on which sending and receiving ESPNOW data.

    choice WIFI_DATARATE
        prompt "WiFi datarate"
        default WIFI_DATARATE_24
        help
            WiFi datarate.

        config WIFI_DATARATE_6
            bool "6 MBps"
        config WIFI_DATARATE_9
            bool "9 MBps"
        config WIFI_DATARATE_12
            bool "12 MBps"
        config WIFI_DATARATE_18
            bool "18 MBps"
        config WIFI_DATARATE_24
            bool "24 MBps"
        config WIFI_DATARATE_36
            bool "36 MBps"
        config WIFI_DATARATE_48
            bool "48 MBps"
        config WIFI_DATARATE_56
            bool "56 MBps"
    endchoice

endmenu
```

## software/components/spi_manager/Kconfig.projbuild
```kconfig
menu "Quad_SPI"

    choice SPI_DATARATE
        prompt "SPI datarate"
        default SPI_DATARATE_6
        help
            SPI datarate.

        config SPI_DATARATE_1
            bool "1 MHz"
        config SPI_DATARATE_2
            bool "2 MHz"
        config SPI_DATARATE_3
            bool "3 MHz"
        config SPI_DATARATE_4
            bool "4 MHz"
        config SPI_DATARATE_6
            bool "6 MHz"
        config SPI_DATARATE_8
            bool "8 MHz"
    endchoice

endmenu
```

## software/main/Kconfig.projbuild
```kconfig
menu "Main App"
	
	config N_SLAVES
        int "SPI slave nb"
        default 6
        range 0 8
        help
            Number of SPI slaves to handle.

    config SPI_WDT
        int "SPI watchdog value"
        default 20
        help
            Maximum number of SPI communication that can be done with one slave until a valid eth/wifi frame is received.
            If no valid eth/wifi as been received in time, the masterboard disables itself and send zeros to every slaves.

    config SPI_N_ATTEMPT
        int "SPI nb of attempts"
        default 2
        range 0 4
        help
            Maximum number of attempts in one spi communication (for one slave).

	config LED_GPIO
        int "Built-In LED GPIO"
        default 2
        range 0 39
        help
            Output GPIO on which the built-in led is wired.    

	config BUTTON_GPIO
	        int "Intput button GPIO"
	        default 36
	        range 0 39
	        help
	            Input GPIO on which the button (pull-down) is wired.

endmenu
```
